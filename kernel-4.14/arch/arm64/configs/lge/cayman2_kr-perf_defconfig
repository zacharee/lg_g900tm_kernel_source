## kernel-4.14/drivers/gpu/drm/mediatek/chargepump/Kconfig
```kconfig
config CUSTOM_KERNEL_CHARGEPUMP
	bool "chargepump Support"
	default n
	help
	  This feature Option is used for projects which using exteranl backlight driver
	  if you want to  external backlight driver, please turn on this feature first,
	  then LED driver call external backlight driver API.
	  Also this feature related to flashlight and DSV driver.

config CUSTOM_KERNEL_CHARGEPUMP_LIST
	string "define external chargepump driver"
	help
	  chargepump driver list for external backlight and dsv chip

config LGE_CHARGEPUMP_LM36272
	bool "LM36272 LED DSV chargepump"
	default n
	help
	  charge pump driver for external backlight and flashlight
	  it support DSV, flashlight, LED module.
	  if you want to use external backlight driver moulde on your project,
	  please turn on chargepump option also.

config LEDS_OPR_MODE_RECOVERY
	bool "backlight operation mode recovery"
	default n
	help
		when the register for the operation mode of backlight has abnormal value,
		this feature recovers the value of register to normal value when the backlight turns on.

config LGE_USE_BRIGHTNESS_TABLE
	bool "Support backlight controlled by lge brightness table"
	---help---
	  This option enables support brightness table to set brightness.
	  Set y to support.
	  Set n to not support.
```

## kernel-4.14/drivers/gpu/drm/mediatek/lge/Kconfig
```kconfig
config LGE_DISPLAY_COMMON
	bool "LGE DISPLAY COMMON"
	default n
	help
	The LGE DISPLAY COMMON feature.

config LGE_DISPLAY_TUNING_SUPPORT
	bool "LGE DISPLAY TUNING SUPPORT"
	default n
	help
	The LGE DISPLAY TUNING feature.
```

## kernel-4.14/drivers/input/fingerprint/Kconfig
```kconfig
#
#Fingerprint
#
menu "Fingerprint support"
	depends on INPUT

config SUNWAVE_TEE_FINGERPRINT
    bool "SW Fingerprint"
    default n
    ---help---
    SW fingerprint chip.

config MTK_FINGERPRINT_SUPPORT
	bool "Mediatek Fingerprint"
	default n
	help
	  Fingerprint mtk driver enable/disable
	  in the kernel.Say Y here if you want to
	  use mediatek fingerprint driver,fingerprint
	  driver will support fingerprint function

if MTK_FINGERPRINT_SUPPORT
#config MTK_FINGERPRINT_SELECT
#	string "sensor type"
#	default "GF318M"


#if MTK_FINGERPRINT_SELECT = "FPC1145"
#config FPC_FINGERPRINT
config FINGERPRINT_FPC
	bool "FPC Fingerprint"
#	default y
#	help
#	  FPC fingerprint FPC's 102x/104x device.
config FINGERPRINT_ID_HI_FPC
	bool "fp id is high"
	default n

config FINGERPRINT_ID_LO_FPC
	bool "fp id is low"
	default n
#endif

#if MTK_FINGERPRINT_SELECT = "GF318M" ||  MTK_FINGERPRINT_SELECT = "GF5216"
#config GOODIX_FINGERPRINT
config FINGERPRINT_GOODIX
	bool "Goodix Fingerprint"
#	default y
#	help
#	  Goodix Fingerprint chip GF316M/GF318M/
#	  GF3118M/GF518M/GF5118M/GF516M/GF816M/
#	  GF3208/GF3206/GF3266/GF3288/GF5206/
#	  GF5216/GF5208 TEE driver

#config GOODIX_SENSOR_TYPE
#	string "SENSOR_TYPE"
#	default "GF5216"
#	help
#	  Must input sensor type, or default is
#	  GF316M GF318M GF3118M GF518M GF5118M
#	  GF516M GF816M GF3208 GF3206 GF3266
#	  GF3288 GF5206 GF5216 GF5208
#endif

config FINGERPRINT_EGISTEC_FOD
	bool "Egistec FOD Fingerprint"
	default n

config FINGERPRINT_EGISTEC
	bool "Egistec Fingerprint"
	default n

config FINGERPRINT_ID_HI_EGISTEC
	bool "fp id is high"
	default n

config FINGERPRINT_ID_LO_EGISTEC
	bool "fp id is low"
	default n

config FINGERPRINT_CDFINGER
	bool "Fingertech Fingerprint"
	default n

config FINGERPRINT_ID_HI_CDFINGER
	bool "fp id is high"
	default n

config FINGERPRINT_ID_LO_CDFINGER
	bool "fp id is low"
	default n

config FINGERPRINT_FOCALTECH
	bool "Fingertech Fingerprint"
	default n

config FINGERPRINT_ID_HI_FOCALTECH
	bool "fp id is high"
	default n

config FINGERPRINT_ID_LO_FOCALTECH
	bool "fp id is low"
	default n

endif
endmenu
```

## kernel-4.14/drivers/input/touchscreen/ILI7807Q/Kconfig
```kconfig
#
# ILITEK ILI7807Q touchscreen driver configuration
#

config TOUCHSCREEN_ILI7807Q
	bool "ILITEK ILI7807Q"
	default n
	help
	  Say Y here if you have a ILITEK ILI7807Q touchscreen connected
	  to your system.

	  If unsure, say N.
```

## kernel-4.14/drivers/input/touchscreen/mediatek/sw49107/Kconfig
```kconfig
#
# LGE touch core configuration
#

if INPUT_TOUCHSCREEN

menuconfig LGE_TOUCH_CORE
	bool "LGE Touch Core - Generic"
	select LGE_TOUCH_CORE_BASE
	help
	  If your plaform is generic linux, say Y

menuconfig LGE_TOUCH_CORE_MTK
	bool "LGE Touch Core - MTK"
	select LGE_TOUCH_CORE_BASE
	help
	  If your plaform is mtk linux, say Y

menuconfig LGE_TOUCH_CORE_QCT
	bool "LGE Touch Core - QCT"
	select LGE_TOUCH_CORE_BASE
	help
	  If your plaform is qct linux, say Y

config LGE_TOUCH_CORE_BASE
	bool "LGE Touch Core Base"
	depends on SPI_MASTER && I2C

config LGE_TOUCH_FW_PATH
	string "LGE Touch Core Firmware Path"
	help
	LGE_TOUCH_FW_PATH is set to path of touch firmware

config LGE_TOUCH_MODULE_DETECT
	bool "LGE Touch Core - Enable Module detection"
	select LGE_TOUCH_CORE_BASE
	default n
	help
	Feature for read device maker id, like lcd or touch maker

config SECURE_TOUCH
	bool "Secure Touch"
	help
	If touch dualization is applied, say Y

config LGE_TOUCH_USE_PANEL_NOTIFY
	bool "Use lge_panel_notify.h"
	help
	If you use lge_panel_notify.h, say Y

menuconfig LGE_TOUCH_LGSIC_SW49107
        bool "LGE Touch Core ODM Device Driver - SW49107"
        depends on LGE_TOUCH_CORE_BASE
        help
          If your device is sw49107, say Y
endif
```

## kernel-4.14/drivers/misc/mediatek/thermal/lge/Kconfig
```kconfig
config LGE_PM_VTS
	bool "LG Electronic Virtual Thermal Sensor"
	default n
	depends on LGE_PM && THERMAL
	help
	  Virtual Sensor representing real world temperature

config LGE_PM_BACKLIGHT_COOLER
	bool "LG Electronic Backlight Cooler Scenario"
	default n
	depends on LGE_PM && THERMAL
	help
	  Say Y to apply LG Electronics backlight cooler behavior
```

## kernel-4.14/drivers/power/supply/mediatek/lge/Kconfig
```kconfig
if LGE_PM

config LGE_PM_BATTERY_CYCLE
	bool "LG Electronic battery cycle count"
	default n
	help
	  Say Y here to support battery cycle count.

config LGE_PM_BATTERY_AGING_FACTOR
	bool "LG Electronic battery aging factor"
	default n
	depends on LGE_PM_BATTERY_CYCLE
	help
	  Say Y here to support battery aging factor.

config LGE_PM_BATTERY_ID
	bool "LG Electronic Battery ID"
	default n
	help
	  Say Y here to support check battery id.

config LGE_PM_BATTERY_NTC_TUNED
	bool "LG Electronic Battery NTC Tuning value"
	default n
	help
	  Say Y here to use tuning value of battery NTC.

config LGE_PM_BATTERY_PRESENT
	bool "LG Electronic Battery present related patch"
	default n
	help
	  Say Y here to apply battery present handling patch.

config LGE_PM_CHARGERLOGO
	bool "LG Electronic Chargerlogo related patch"
	default n
	help
	  Say Y here to apply patch for running chargerlogo.

config LGE_PM_CHARGER_CONTROLLER
	bool "LG Electronic Charger Controller"
	default n
	help
	  Say Y here to enable charger-controller.
	  This manage LG Electronics charging scenarios.

config LGE_PM_DEBUG_FS
	bool "LG Electronic debugfs for power management"
	depends on DEBUG_FS
	default n
	help
	  Say Y here to support power devices debugfs.

config LGE_PM_POWER_SYSFS
	bool "LG Electronic unified power sysfs"
	default n
	help
	  Say Y here to support unified power sysfs.

config LGE_PM_PSEUDO_POWER_SUPPLY
	bool "LG Electronic pseudo battery"
	default n
	help
	  Say Y here to support fake battery.

config LGE_PM_PSEUDO_BATTERY
	bool "LG Electronic pseudo battery"
	select LGE_PM_PSEUDO_POWER_SUPPLY
	default n
	help
	  Say Y here to support fake battery.

config LGE_PM_PSEUDO_HVDCP
	bool "LG Electronic pseudo hvdcp"
	select LGE_PM_PSEUDO_POWER_SUPPLY
	default n
	help
	  Say Y here to support fake hvdcp.

config LGE_PM_PUMP_EXPRESS_PLUS_ALGO
	bool "LG Electronic pump express plus 1.0 / 2.0 software pulse"
	default n
	help
	  Say Y here to support pump express plus 1.0 / 2.0 software pulse

config LGE_PM_QNOVO_QNS
	bool "QNOVO QNS System support"
	default n
	help
	  Say Y to enable support QNOVO QNS system

config LGE_PM_USB_ID
	bool "Support LGE PM USB ID feature"
	default n
	help
	  LGE PM USB ID about cable detection, etc

config LGE_PM_WIRELESS_CHARGER
	bool "Support LGE PM wireless charger"
	default n
	help
	  Say Y here to support wireless charger.

endif # LGE_PM

config CHARGER_BQ25910
	bool "Driver for Texas Instruments BQ25910 Charger IC"
	default n
	depends on MTK_CHARGER
	help
	  Say Yes to support Texas Instruments BQ25910.
	  It is mainly used as slave IC for dual charger application.

config CHARGER_BQ25970
	bool "Texas Instruments BQ25970 Switched Cap Fast Charger"
	default n
	depends on MTK_CHARGER
	help
	  Say Yes to support Texas Instruments BQ25970.

config CHARGER_MAX77932
	bool "Maxim MAX77932 Dual Phase Switched Capacitor Converter"
	default n
	depends on MTK_CHARGER
	select REGMAP_I2C
	help
	  This driver controls Maxim MAX77932 Dual Phase Switched Capacitor
	  Converter via I2C bus. The converter delivers the output which is
	  equal to the input voltage divided by 2. Say Y here to
	  enable the charger driver for the converter.

config WIRELESS_CHARGER_RX_RT1653
	bool "Driver for Richtek RT1653 wireless charger receiver IC"
	default n
	depends on MTK_CHARGER
	help
	  Say Yes to support Richtek RT1653.

config WIRELESS_CHARGER_RX_P9222
	bool "Driver for IDT P9222 wireless charger receiver IC"
	default n
	depends on MTK_CHARGER
	help
	  Say Yes to support IDT P9222.
```

## kernel-4.14/drivers/scsi/ufs/Kconfig.lfs
```kconfig
config LFS_UFS
	bool
	default y if LFS_COMMON

config LFS_UFS_SYSFS_COMMON
	bool
	default y if LFS_COMMON

config LGE_UFS_PWR_MODE_CHANGE
	depends on MACH_LGE
	bool "LGE UFS power mode change feature"
	default n
	help
		Say y here to support LGE UFS power mode change feature.
		LGE_UFS_PWR_MODE_CHANGE is related with LGE Specific.
		We try to change UFS VCCQ power mode with temperature condition.
```
